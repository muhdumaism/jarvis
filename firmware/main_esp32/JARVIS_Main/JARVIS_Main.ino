/**
 * JARVIS Main Coordinator Gateway Firmware
 * 
 * Implements a task-based FreeRTOS architecture on ESP32 WROOM-32.
 * Core 0: Digital audio capture/VAD and Websocket network streams.
 * Core 1: TFT eyes animations rendering.
 */

#include "config.h"
#include "system_monitor.h"
#include "tft_driver.h"
#include "ui_manager.h"
#include "mic_capture.h"
#include "audio_output.h"
#include "ws_client.h"
#include "espnow_gateway.h"

#include <WiFi.h>
#include <libb64/cencode.h> // Standard ESP32 base64 encoder

// FreeRTOS Task Handles
TaskHandle_t UITaskHandle = NULL;
TaskHandle_t VoiceTaskHandle = NULL;
TaskHandle_t NetworkTaskHandle = NULL;

// Shared Voice State variables
bool isCapturingVoice = false;
unsigned long lastSpeechTime = 0;
const int energyVADThreshold = 400; // Energy VAD trigger floor (lowered to 400 for far-field room pickup)
const int VADStartDuration = 150;   // Speak for 150ms to trigger
const int VADEndDuration = 1000;    // Silence for 1000ms (1 second) to stop

// Base64 encoding helper
String base64Encode(const uint8_t* data, size_t len) {
    base64_encodestate state;
    base64_init_encodestate(&state);
    
    // Output size estimation: 4/3 of input + padding + room for null terminator
    char* encoded = new char[((len + 2) / 3) * 4 + 1];
    
    int encodedLen = base64_encode_block((const char*)data, len, encoded, &state);
    encodedLen += base64_encode_blockend(encoded + encodedLen, &state);
    encoded[encodedLen] = '\0';
    
    // Prune trailing newlines if generated by encoder
    String result = String(encoded);
    result.trim();
    
    delete[] encoded;
    return result;
}

// ------------------------------------------------------------
// Core 1 Task: UI Rendering & Eyes Animations
// ------------------------------------------------------------
void UITask(void* pvParameters) {
    Serial.println("[TASK] UI Loop started on Core 1");
    initUI();

    for (;;) {
        updateUI();
        feedWatchdog();
        vTaskDelay(pdMS_TO_TICKS(16)); // ~60 FPS update speed for buttery smooth animations
    }
}

// ------------------------------------------------------------
// Core 0 Task: Audio Capture & Energy VAD checking
// ------------------------------------------------------------
void VoiceTask(void* pvParameters) {
    Serial.println("[TASK] Voice Capture Loop started on Core 0");
    initMicrophone();
    initAudioOutput();

    static uint8_t audioBuffer[2048]; // ~64ms buffer size at 16kHz
    size_t bytesRead = 0;
    unsigned long speechAccumulator = 0;
    unsigned long lastVADCheck = millis();

    for (;;) {
        if (readMicrophone(audioBuffer, sizeof(audioBuffer), &bytesRead) && bytesRead > 0) {
            // Calculate average RMS energy to detect voice
            // 1. Calculate DC offset (mean value of samples) to remove background bias
            long sampleSum = 0;
            int samples = bytesRead / 2;
            int16_t* pcmSamples = (int16_t*)audioBuffer;
            for (int i = 0; i < samples; i++) {
                sampleSum += pcmSamples[i];
            }
            int dcOffset = samples > 0 ? (sampleSum / samples) : 0;

            // 2. Calculate average energy by removing the DC offset from each sample
            long sum = 0;
            for (int i = 0; i < samples; i++) {
                sum += abs(pcmSamples[i] - dcOffset);
            }
            int avgEnergy = samples > 0 ? (sum / samples) : 0;
            unsigned long now = millis();

            static unsigned long lastLogTime = 0;
            if (now - lastLogTime > 1000) {
                Serial.printf("[VAD LOG] Energy: %d | DC Bias: %d | Threshold: %d | State: %s\n", 
                              avgEnergy, dcOffset, energyVADThreshold, isCapturingVoice ? "RECORDING" : "IDLE");
                lastLogTime = now;
            }

            // VAD Speech Gate check
            if (avgEnergy > energyVADThreshold) {
                lastSpeechTime = now;
                if (!isCapturingVoice) {
                    speechAccumulator += (now - lastVADCheck);
                    if (speechAccumulator > VADStartDuration) {
                        isCapturingVoice = true;
                        Serial.println("[VAD] Speech detected. VOICE_START trigger.");
                        setSystemState("LISTENING"); // Instant local screen change
                        
                        // Send start event
                        StaticJsonDocument<128> doc;
                        doc["type"] = "VOICE_START";
                        doc["client_id"] = CLIENT_ID;
                        
                        String msg;
                        serializeJson(doc, msg);
                        sendWSMessage(msg);
                    }
                }
            } else {
                if (!isCapturingVoice) {
                    speechAccumulator = 0; // Reset trigger accumulator
                }
            }
            lastVADCheck = now;

            // Handle voice streaming to server
            if (isCapturingVoice) {
                // Encode and stream current raw audio frame
                String b64Audio = base64Encode(audioBuffer, bytesRead);
                
                StaticJsonDocument<3072> doc;
                doc["type"] = "VOICE_AUDIO";
                doc["audio"] = b64Audio;
                
                String msg;
                serializeJson(doc, msg);
                sendWSMessage(msg);

                // Silence boundary check
                if (now - lastSpeechTime > VADEndDuration) {
                    isCapturingVoice = false;
                    speechAccumulator = 0;
                    Serial.println("[VAD] Silence timeout. VOICE_END trigger.");
                    setSystemState("THINKING"); // Instant local screen change
                    
                    StaticJsonDocument<128> docEnd;
                    docEnd["type"] = "VOICE_END";
                    
                    String msgEnd;
                    serializeJson(docEnd, msgEnd);
                    sendWSMessage(msgEnd);
                }
            }
        }
        vTaskDelay(pdMS_TO_TICKS(2));
    }
}

// ------------------------------------------------------------
// Core 0 Task: WebSocket Connection and Network Management
// ------------------------------------------------------------
void NetworkTask(void* pvParameters) {
    Serial.println("[TASK] Network Management started on Core 0");
    
    // Connect to WiFi
    WiFi.begin(WIFI_SSID, WIFI_PASSWORD);
    Serial.printf("[WIFI] Connecting to SSID: %s\n", WIFI_SSID);
    
    while (WiFi.status() != WL_CONNECTED) {
        vTaskDelay(pdMS_TO_TICKS(500));
        Serial.print(".");
    }
    Serial.println("\n[WIFI] Wi-Fi connected! IP address: ");
    Serial.println(WiFi.localIP());
    Serial.printf("[WIFI] Operating Channel: %d\n", WiFi.channel());

    initWebSocket();
    initESPNOWGateway();

    unsigned long lastStatsPrint = 0;

    for (;;) {
        loopWebSocket();

        // Feed system watchdog periodically
        checkWatchdog();

        // Print heap memory usage logs and report heartbeat every 10 seconds
        if (millis() - lastStatsPrint > 10000) {
            printSystemStats();
            
            // Send Gateway heartbeat over WebSocket to auto-register on Dashboard
            char payload[256];
            snprintf(payload, sizeof(payload),
                     "{\"type\":\"NODE_HEARTBEAT\",\"node_id\":\"gateway_main\",\"uptime\":%lu,\"free_heap\":%u,\"mac_address\":\"%s\",\"chip_type\":\"esp32\",\"device_count\":0,\"device_states\":0}",
                     millis() / 1000, esp_get_free_heap_size(), WiFi.macAddress().c_str());
            sendWSMessage(payload);
            
            lastStatsPrint = millis();
        }
        
        vTaskDelay(pdMS_TO_TICKS(2));
    }
}

void setup() {
    Serial.begin(115200);
    delay(1000);
    Serial.println("[BOOT] Starting JARVIS OS main unit...");

    initSystemMonitor();

    // 1. Launch UI Thread on Core 1 (strictly isolated from network delays)
    xTaskCreatePinnedToCore(
        UITask,
        "UI_Task",
        16384, // Increased to prevent GFX/caching stack overflow
        NULL,
        2,
        &UITaskHandle,
        1
    );

    // 2. Launch Voice thread on Core 0
    xTaskCreatePinnedToCore(
        VoiceTask,
        "Voice_Task",
        12288, // Increased from 4096 to safely hold JSON and audio buffers
        NULL,
        3, // higher priority for audio capture
        &VoiceTaskHandle,
        0
    );

    // 3. Launch Network thread on Core 0
    xTaskCreatePinnedToCore(
        NetworkTask,
        "Network_Task",
        16384, // Increased from 8192 to prevent WebSocket/JSON parser overflows
        NULL,
        2,
        &NetworkTaskHandle,
        0
    );
}

void loop() {
    // Empty loop — tasks handles execution
    vTaskDelay(pdMS_TO_TICKS(1000));
}
